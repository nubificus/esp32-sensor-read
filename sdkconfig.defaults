## sdkconfig.defaults.esp32c6
```kconfig
# ESP32-C6 specific configuration - ESP-IDF 6.0
# ESP32-C6 is a RISC-V MCU with native IEEE 802.11b/g/n/ax WiFi (WiFi 6)
# Standard C6 dev boards have no external PSRAM; disable SPIRAM from base config.
# No esp_hosted/wifi_remote needed: native WiFi stack is used directly.
# CONFIG_SPIRAM is not set
```

## sdkconfig.defaults.esp32p4
```kconfig
# ESP32-P4 specific configuration - ESP-IDF 6.0
# ESP32-P4 uses a high-speed MSPI PSRAM controller; SPIRAM_MODE_QUAD/OCT
# do not apply. IDF auto-detects PSRAM geometry on this chip.
CONFIG_ESPTOOLPY_FLASHSIZE_16MB=y
CONFIG_SPIRAM=y
CONFIG_SPIRAM_BOOT_INIT=y
CONFIG_SPIRAM_USE_MALLOC=y
CONFIG_SPIRAM_MALLOC_ALWAYSINTERNAL=16384
CONFIG_SPIRAM_MALLOC_RESERVE_INTERNAL=32768
CONFIG_ESP_HOST_WIFI_ENABLED=y
```
